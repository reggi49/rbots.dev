## board/main/Kconfig
```kconfig
menuconfig RBOT_ENABLE_APP_HEARTBEAT_LOG
    bool "Enable periodic STATE heartbeat log"
    default n
    help
        Log "STATE: RUNNING" every 5 seconds. Enable only for debugging; disable in production to reduce
        log spam once AI/NET/heartbeat events are stable.

menuconfig RBOT_ENABLE_TOUCH_WAKE
    bool "Enable touch-triggered wakeword"
    default y
    help
        Treat a rising edge on the touch pin (GPIO0) as an artificial wakeword trigger.
        This simply calls board_wakeword_notify(1.0f) for debugging and does not change any
        GPIO mappings or pipeline behavior. Keep it disabled for production.
```

## board/main/Kconfig.projbuild
```kconfig
menu "RBOT"

config RBOT_ENABLE_CHAT_CONSOLE
    bool "Enable chat console + auto hello (debug only)"
    default n
    help
        Enables the interactive serial chat console and the auto 'hello' demo request.
        Keep this OFF for production voice pipeline to reduce RAM usage and avoid
        unintended background cloud requests.

config RBOT_ENABLE_AUTO_HELLO
    bool "Enable auto hello demo (debug only)"
    default n
    help
        Auto-send a 'hello' chat request on boot for debugging. Keep OFF for production.

config RBOT_ENABLE_VOICE_PIPELINE
    bool "Enable voice pipeline (wake word + capture + STT + AI + TTS)"
    default y
    help
        Main voice pipeline. Disable only for minimal debug builds without audio/AI.

config RBOT_DEBUG_WW_BANNER
    bool "Enable wake-word banner prints (debug only)"
    default n
    help
        Enables the wake-word model banner prints at boot. Keep OFF in production.

config TFT_MINIMAL_TEST
    bool "TFT minimal test mode (color cycle only)"
    default n
    help
        If enabled, app_main runs only the TFT color-cycle test and then
        sleeps forever. No I2S, Wi-Fi, or other peripherals are initialized.

endmenu
```

## board/sdkconfig.defaults
```kconfig
CONFIG_IDF_TARGET="esp32s3"
CONFIG_IDF_TARGET_ESP32S3=y
CONFIG_IDF_TARGET_ARCH_XTENSA=y
CONFIG_ESPTOOLPY_FLASHSIZE_16MB=y
CONFIG_ESPTOOLPY_FLASHSIZE="16MB"
CONFIG_PARTITION_TABLE_CUSTOM=y
CONFIG_PARTITION_TABLE_CUSTOM_FILENAME="partitions_singleapp.csv"
CONFIG_ESP_WIFI_STATIC_RX_BUFFER_NUM=8
CONFIG_ESP_WIFI_DYNAMIC_RX_BUFFER_NUM=16
CONFIG_ESP_WIFI_DYNAMIC_TX_BUFFER_NUM=16
CONFIG_ESP_WIFI_TX_BA_WIN=4
CONFIG_ESP_WIFI_RX_BA_WIN=4
CONFIG_ESP_WIFI_MGMT_SBUF_NUM=24
CONFIG_ESP_WIFI_IRAM_OPT=y
CONFIG_SR_WN_WN9_ALEXA=y
CONFIG_ESP32S3_SPIRAM_SUPPORT=y
CONFIG_SPIRAM_MODE_OCT=y
CONFIG_SPIRAM=y
CONFIG_ESP_MAIN_TASK_STACK_SIZE=10240
CONFIG_ESP_CONSOLE_UART_DEFAULT=y
CONFIG_ESP_CONSOLE_UART_BAUDRATE=115200
CONFIG_ESP_SYSTEM_EVENT_TASK_STACK_SIZE=4096

# Bluetooth & NimBLE Configuration (Reproducible Build)
CONFIG_BT_ENABLED=y
CONFIG_BT_BLUEDROID_ENABLED=n
CONFIG_BT_NIMBLE_ENABLED=y
CONFIG_BT_CONTROLLER_ENABLED=y
CONFIG_BT_NIMBLE_ROLE_PERIPHERAL=y
CONFIG_BT_NIMBLE_ROLE_BROADCASTER=y
CONFIG_BT_NIMBLE_GATT_SERVER=y
CONFIG_BT_NIMBLE_PINNED_TO_CORE_0=y
CONFIG_BT_NIMBLE_PINNED_TO_CORE=0
CONFIG_BT_NIMBLE_HOST_TASK_STACK_SIZE=4096
CONFIG_BT_NIMBLE_MEM_ALLOC_MODE_INTERNAL=y
CONFIG_BT_NIMBLE_MAX_CONNECTIONS=3
CONFIG_BT_NIMBLE_ATT_PREFERRED_MTU=512
CONFIG_ESP_COEX_SW_COEXIST_ENABLE=y
```
